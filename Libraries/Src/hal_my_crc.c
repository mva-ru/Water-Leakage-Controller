#include "hal_my_crc.h"
#include "hal_my_lib.h"

// Таблица для расчета контрольной суммы
const u8 auchCRCHi[256] =
{
   0x00, 0xC1, 0x81, 0x40, 0x01, 0xC0, 0x80, 0x41, 0x01, 0xC0, 0x80, 0x41, 0x00, 0xC1, 0x81,
   0x40, 0x01, 0xC0, 0x80, 0x41, 0x00, 0xC1, 0x81, 0x40, 0x00, 0xC1, 0x81, 0x40, 0x01, 0xC0,
   0x80, 0x41, 0x01, 0xC0, 0x80, 0x41, 0x00, 0xC1, 0x81, 0x40, 0x00, 0xC1, 0x81, 0x40, 0x01,
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   0x00, 0xC1, 0x81, 0x40, 0x01, 0xC0, 0x80, 0x41, 0x01, 0xC0, 0x80, 0x41, 0x00, 0xC1, 0x81, 0x40
};

// Таблица для расчета контрольной суммы
const u8 auchCRCLo[256] =
{
   0x00, 0xC0, 0xC1, 0x01, 0xC3, 0x03, 0x02, 0xC2, 0xC6, 0x06, 0x07, 0xC7, 0x05, 0xC5, 0xC4,
   0x04, 0xCC, 0x0C, 0x0D, 0xCD, 0x0F, 0xCF, 0xCE, 0x0E, 0x0A, 0xCA, 0xCB, 0x0B, 0xC9, 0x09,
   0x08, 0xC8, 0xD8, 0x18, 0x19, 0xD9, 0x1B, 0xDB, 0xDA, 0x1A, 0x1E, 0xDE, 0xDF, 0x1F, 0xDD,
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   0x44, 0x84, 0x85, 0x45, 0x87, 0x47, 0x46, 0x86, 0x82, 0x42, 0x43, 0x83, 0x41, 0x81, 0x80, 0x40
};

/************************************************************************
									 Прототипы всех функций и методов модуля
*************************************************************************/
u16 Crc_16				(u8 *p,  u16 len);																			// Расчет контрольной суммы CRC16
u8  Lrc_8				  (u8 *p, u8 len);																				// Расчет контрольной суммы LRC8 для массива u8 (цифры)
u8 	Lrc_8_Ascii		(u8 *p, u8 len);																				// Расчет контрольной суммы LRC8 для массива Ascii (символы)
u8  Crc_8_Magazin (u8 *p,  u8 len);																				// Расчет контрольной суммы CRC8 для журналирования
u8 	Crc_8_Config  (u8 *p,  u8 len);																				// Расчет контрольной суммы пакета для записи параметра конф-и в память
u8  Crc_8_Config_2(u8 *p,  u8 len, u8 nS);																// Расчет контрольной суммы пакета для записи параметра конф-и в память
u8  Crc_8_Ds1820  (u8 *bf, u8 ne,  u8 size);															// Расчет контрольной суммы CRC8 для датчиков серии "DS18S20" и  "DS18B20"
u8  Crc_8_QT60168 (u8 *p,  u8 len);																				// Расчет контрольной суммы CRC8 для работы с драйвером сенсорной клавиатуры QT60168
//------------------------------------------------------------------------

/**
  * @brief        Расчет контрольной суммы CRC16
	* @param	  *p:	Ссылка на буфер для передачи данных через порт
	* @param	 len:	Размер пакета (в байтах)		
	* @retval  crc: Возвращает контрольную сумму
  */
u16 Crc_16(u8 *p, u16 len)
{
	 if (len > 256U)
		 return (0);
		
	 u8 idx = 0; 
   u8 crc_hi = 0xFF; 
   u8 crc_lo = 0xFF;
	 
   do
   {
		 idx  = crc_hi ^ *p++;         
     crc_hi = crc_lo ^ auchCRCHi[idx];   
     crc_lo =          auchCRCLo[idx];
   }
   while (--len);                      
	 
   return ((crc_hi << 8) | crc_lo);
}

/**
  * @brief        Расчет контрольной суммы LRC8 для массива u8 (цифры)
	* @param	  *p:	Ссылка на буфер
	* @param	 len:	Размер пакета (в байтах)		
	* @retval  crc: Возвращает контрольную сумму
  */
u8 Lrc_8(u8 *p, u8 len)
{
	u8 crc = 0;				
	
	for(u8 i = 0; i < len; i++)
		crc += p[i];
//		crc += p[i]*44111;// рекомендация с хабрахабра, ниже вероятность ошибки				
	
	crc ^= 0xff; 			// первое дополнение
	crc += 1; 				// второе дополнение	
  return crc;
}

/**
  * @brief        Расчет контрольной суммы LRC8 для массива Ascii (символы)
	* @param	  *p:	Ссылка на буфер
	* @param	 len:	Размер пакета (в байтах)		
	* @retval  crc: Возвращает контрольную сумму
  */
u8 Lrc_8_Ascii(u8 *p, u8 len)
{
	u8 crc  = 0;
	u8 size = len-4;				
	
	for(u8 i = 1; i < size; i+=2)
		crc += (MyLib_Convert_Char_In_Digit(p[i])<<4 | 
						MyLib_Convert_Char_In_Digit(p[i+1]));
//		crc += p[i]*44111;// рекомендация с хабрахабра, ниже вероятность ошибки				
	
	crc ^= 0xff; 			// первое дополнение
	crc += 1; 				// второе дополнение	
  return crc;
}

/**
	* @brief        Расчет контрольной суммы пакета для журналирования
  * @param	  *p:	Ссылка на пакет 
	* @param	 len:	Размер пакета (в байтах)		
	* @retval  crc: Возвращает контрольную сумму
  */
u8 Crc_8_Magazin(u8 *p, u8 len)
{
	u8 crc = 0;
	u8 size = len-1;

	for(u8 i = 0; i < size; i++)
		crc += p[i];

  return crc;
}

/**
	* @brief        Расчет контрольной суммы пакета для записи параметра конф-и в память
  * @param	  *p:	Ссылка на пакет 
	* @param	 len:	Размер пакета (в байтах)		
	* @retval  crc: Возвращает контрольную сумму
  */
u8 Crc_8_Config(u8 *p, u8 len)
{
	u8  crc = 0;
	u16 size = 2+len-1;																	

	for(u16 i = 2; i < size; i++)												// Начинаем со 2 элемента (0 и 1 байты адрес EEPROM - тип u16)
		crc += p[i];

  return crc;
}

/**
	* @brief        Расчет контрольной суммы пакета для записи параметра конф-и в память
  * @param	  *p:	Ссылка на пакет 
	* @param	 len:	Размер пакета (в байтах)
	* @param	  nS:	Номер элемента массива с которого начать считать
	* @retval  crc: Возвращает контрольную сумму
  */
u8 Crc_8_Config_2(u8 *p, u8 len, u8 nS)
{
	u8  crc = 0;
	u16 size = nS+len-1;																	

	for(u16 i = nS; i < size; i++)												
		crc += p[i];

  return crc;
}

/**
	* @brief        Расчет контрольной суммы CRC для датчиков серии "DS18S20" и  "DS18B20"
	* @param	 *bf:	Ссылка на буфер для передачи данных через порт
	* @param    ne:	Номер элемента массива с которого начать
	* @param  size:	Размер пакета (в байтах)		
	* @retval  crc: Возвращает контрольную сумму
  */
u8 Crc_8_Ds1820 (u8* bf, u8 ne, u8 size)
{
	static u8 crc, tmp, vh;
	crc = 0, tmp = 0, vh = 0;
	bf += ne;
	
  for(u8 j = 0; j < size; j++)
	{
    tmp = *bf;		
    for (u8 i = 0; i != 8; i++)
		{
      vh = (tmp & 0x1) ^ (crc & 0x1);
      crc >>= 1;
			
      if (vh)
			{
				vh <<= 2;
        crc ^= vh;
        vh <<= 1;
        crc ^= vh;
        vh <<= 4;
        crc ^= vh;
      }
      tmp >>= 1;
    }
    bf++;
  }
  return crc;
}

/**
	* @brief       Расчет контрольной суммы CRC8 для работы с драйвером сенсорной клавиатуры QT60168
	* @param	 *p: Ссылка на буфер с данными для рсчета
	* @param	len: Размер буфера (в байтах)		
	* @retval  u8: Возвращает контрольную сумму
  */
u8 Crc_8_QT60168(u8 *p, u8 len)
{ 
	static u8 data;
	static u8 fb;				
	static u8 crc; crc = 0;						// конечное CRC
	static u8 idx; 										// счетчик побитного смещения		
	
	for(u8 i = 0; i < len; i++)
	{
		idx = 8; 														
		data = p[i];
		do
		{ 
			fb = (crc ^ data) & 0x01;
			data >>= 1;
			crc >>= 1;
			
			if(fb)
				crc ^= 0x8c;
		} while(--idx);
	}
	return crc;
}
